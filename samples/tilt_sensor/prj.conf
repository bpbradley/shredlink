## CMakeLists.txt
```
# SPDX-License-Identifier: Apache 2.0

cmake_minimum_required(VERSION 3.20.0)

find_package(Zephyr REQUIRED HINTS $ENV{ZEPHYR_BASE})

project(sample_tilt_sensor)

target_sources(app PRIVATE
  src/main.c
)
```

## sample.yaml
```
sample:
  name: Tilt sensor demonstration
  description: Demonstrate basic usage of a tilt sensor
tests:
  sample.sensor.tilt:
    build_only: true
    platform_allow: nrf52840dk_nrf52840
    tags: sensors tilt
```

## prj.conf
```kconfig
# Copyright (c) 2022 Brian Bradley
# SPDX-License-Identifier: Apache-2.0

CONFIG_LOG=y
CONFIG_SENSOR=y
CONFIG_TILT_SENSOR=y
CONFIG_GPIO_TILT_SENSOR=y
CONFIG_TILT_SENSOR_TRIGGER_GLOBAL_THREAD=y
CONFIG_TILT_SENSOR_MINIMUM_HOLD_TIME_MS=150
CONFIG_SENSOR_LOG_LEVEL_DBG=y
```

## boards/blackpill_f411ce.overlay
```dts
/*
 * Copyright 2021 Brian Bradley
 *
 * SPDX-License-Identifier: Apache-2.0
 */

/ {
    tilt0: tilt_0 {
        label = "TILT_0";
        compatible = "gpio-tilt";
        tilt-gpios = <&gpiob 13 (GPIO_ACTIVE_HIGH | GPIO_PULL_UP)>;
    };
};
```

## boards/nrf52840dk_nrf52840.overlay
```dts
/*
 * Copyright 2021 Brian Bradley
 *
 * SPDX-License-Identifier: Apache-2.0
 */

/ {
    tilt0: tilt_0 {
        label = "TILT_0";
        compatible = "gpio-tilt";
        tilt-gpios = <&gpio0 2 (GPIO_PULL_UP | GPIO_ACTIVE_LOW)>;
    };
};
```

## src/main.c
```c
/**
 * @file main.c
 * @date 2022-02-24
 * 
 * @copyright Copyright (C) 2022 Brian Bradley
 * 
 * SPDX-License-Identifier: Apache-2.0
 * 
 */

#include <zephyr/kernel.h>
#include <zephyr/drivers/sensor.h>
#include <drivers/sensor/tilt.h>
#include <zephyr/drivers/gpio.h>

#define LED_ID	DT_ALIAS(led0)
#define TILT_SENSOR	DT_NODELABEL(tilt0)
#define LED_SPEC(node_id) GPIO_DT_SPEC_GET_OR(node_id, gpios, {0})

#ifdef CONFIG_TILT_SENSOR_TRIGGER
static void tilt_trigger_handler(const struct device *dev,
			    const struct sensor_trigger *trig)
{
	struct sensor_value tilt;
	struct gpio_dt_spec led = LED_SPEC(LED_ID);
	int rc;
	rc = sensor_sample_fetch(dev);
	if (rc != 0) {
		printk("tilt sensor fetch error: %d\n", rc);
		return;
	}
	rc = sensor_channel_get(dev, SENSOR_CHAN_TILT, &tilt);
	if (rc != 0) {
		printk("tilt sensor get error: %d\n", rc);
		return;
	}
	printk("Triggered Sample=%d\n", tilt.val1);
	if (led.port){
		gpio_pin_set_dt(&led, tilt.val1);
	}
}
#endif

void main(void)
{
	const struct device *tilt = DEVICE_DT_GET(TILT_SENSOR);
	struct gpio_dt_spec led = LED_SPEC(LED_ID);
	int rc;

	if (led.port){
		gpio_pin_configure_dt(&led, GPIO_OUTPUT_INACTIVE);
	}

	#ifdef CONFIG_TILT_SENSOR_TRIGGER
	static struct sensor_trigger trig;
	trig.type = SENSOR_TRIG_THRESHOLD;
	trig.chan = SENSOR_CHAN_TILT;
	rc = sensor_trigger_set(tilt, &trig, tilt_trigger_handler);
	if (rc != 0) {
		printk("Trigger set failed: %d\n", rc);
		return;
	}
	#endif

	while (1) {
		struct sensor_value tilted = {0};

		if (tilt != NULL){
			if ((rc = sensor_sample_fetch(tilt)) != 0){
				printk("tilt sensor fetch error: %d\n", rc);
			}
			else{
				sensor_channel_get(tilt, SENSOR_CHAN_TILT,
					&tilted);
			}
		}
		printk("Polled Sample=%d\n", tilted.val1);
		if (led.port){
			gpio_pin_set_dt(&led, tilted.val1);
		}
		k_msleep(20000);
	}
}
```
