## extras/drivers/sensor/tilt/Kconfig
```kconfig
# Copyright (c) 2022 Brian Bradley
# SPDX-License-Identifier: Apache-2.0

menuconfig TILT_SENSOR
	bool "Enable tilt sensors"
config GPIO_TILT_SENSOR
    depends on GPIO
    bool "Enable GPIO based tilt sensor driver"
config TILT_SENSOR_TRIGGER
    bool "Enable triggers on tilt sensor drivers"

if GPIO_TILT_SENSOR
rsource "gpio/Kconfig"

choice
	prompt "tilt sensor trigger mode"
	default TILT_SENSOR_TRIGGER_NONE

config TILT_SENSOR_TRIGGER_NONE
	bool "No trigger"

config TILT_SENSOR_TRIGGER_GLOBAL_THREAD
	select TILT_SENSOR_TRIGGER
	bool "Use global thread"

config TILT_SENSOR_TRIGGER_OWN_THREAD
	select TILT_SENSOR_TRIGGER
	bool "Use own thread"

config TILT_SENSOR_THREAD_STACK_SIZE
	int "Sensor delayed work thread stack size"
	depends on TILT_SENSOR_TRIGGER_OWN_THREAD
	default 1024

config TILT_SENSOR_THREAD_PRIORITY
	int "Tilt sensor thread priority"
	depends on TILT_SENSOR_TRIGGER_OWN_THREAD
	default 10
endchoice

endif
```

## extras/drivers/sensor/tilt/gpio/Kconfig
```kconfig
config TILT_SENSOR_MINIMUM_HOLD_TIME_MS
    int "Minimum time the sensor must be in the same state before a trigger"
    depends on TILT_SENSOR_TRIGGER
    default 250
    range 0 1000
    help
      This will prevent errant triggers from short events (such as from vibration)
      but it will (of course) also introduce a latency equal to the hold time.
```

## extras/drivers/wii/Kconfig
```kconfig
# Copyright (c) 2021 Brian Bradley
# SPDX-License-Identifier: Apache-2.0

menuconfig WII_PERIPHERAL_DRIVER
	bool "Wii peripheral driver"
	depends on I2C
	help
	  Enable driver for Wii peripherals.
config WII_WRITE_READ_DELAY_US
	int "Delay time between writing a register and waiting to poll data"
	default 180
	range 0 300
	help
	  Official wii peripherals do not have data available immediately upon request.
	  i2c transactions will fail if there is no wait period. However, some unofficial
	  controllers appear not to have this limitation, and so the delay can be reduced
	  to 0 if using only those peripherals.
config WII_INIT_SEQ_DELAY_US
	int "Delay time between writing command sequences in the init process"
	default 50
	range 0 300
if WII_PERIPHERAL_DRIVER
module = WII
module-str = wii
source "subsys/logging/Kconfig.template.log_config"
endif
```

## extras/dts/bindings/nintendo,wii.yaml
```yaml
description: |
    Nintendo Wii peripheral devices

compatible: "nintendo,wii"

include: i2c-device.yaml
```

## extras/dts/bindings/sensor/gpio-tilt.yaml
```yaml
# Copyright (c) 2022 Brian Bradley
# SPDX-License-Identifier: Apache-2.0

description: |
    GPIO based tilt sensor driver compatible

compatible: "gpio-tilt"
include: base.yaml
properties:
    tilt-gpios:
      type: phandle-array
      required: true
```

## tests/tilt/testcase.yaml
```yaml
tests:
  drivers.sensor.tilt:
    build_only: true
    platform_allow: nrf52840dk_nrf52840
    tags: shredlink tilt
  drivers.sensor.tilt.triggers.global:
    build_only: true
    platform_allow: nrf52840dk_nrf52840
    extra_args: CONFIG_TILT_SENSOR_TRIGGER_GLOBAL_THREAD=y 
    tags: shredlink tilt
  drivers.sensor.tilt.triggers.ownthread:
    build_only: true
    platform_allow: nrf52840dk_nrf52840
    extra_args: CONFIG_TILT_SENSOR_TRIGGER_OWN_THREAD=y
    tags: shredlink tilt
  drivers.sensor.tilt.triggers.nowait:
    build_only: true
    platform_allow: nrf52840dk_nrf52840
    extra_args: CONFIG_TILT_SENSOR_TRIGGER_GLOBAL_THREAD=y CONFIG_TILT_SENSOR_MINIMUM_HOLD_TIME_MS=0
    tags: shredlink tilt
  drivers.sensor.tilt.triggers.hold:
    build_only: true
    platform_allow: nrf52840dk_nrf52840
    extra_args: CONFIG_TILT_SENSOR_TRIGGER_GLOBAL_THREAD=y CONFIG_TILT_SENSOR_MINIMUM_HOLD_TIME_MS=250
    tags: shredlink tilt
  
```

## west.yml
```yaml
# Copyright (c) 2021 Brian Bradley

manifest:

  remotes:
    - name: zephyrproject-rtos
      url-base: https://github.com/zephyrproject-rtos

  projects:
    - name: zephyr
      remote: zephyrproject-rtos
      revision: zephyr-v3.2.0
      import:
        path-prefix: rtos
```
